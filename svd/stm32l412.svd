# STM32L412 register map
File version: 1.9
CPU: CM4 r0p1, little endian, MPU, FPU, 4 interrupt priority bits
Registers are 32-bit, read-write, reset 0x0 unless marked. A register's access mark holds for its fields unless they carry their own. Offsets are from the block's base; lines under a group give offsets from that group; [hi:lo] are bit positions; {n}, {i} and the like mark numbered series; 'fields as' and 'values as' point back to an identical list; <NAME> marks a mode.

## Memory map
0x40000000 TIM2 size 0x400 — General-purpose-timers
0x40001000 TIM6 size 0x400 — Basic-timers
0x40002800 RTC size 0x400 — Real-time clock
0x40002C00 WWDG size 0x400 — System window watchdog
0x40003000 IWDG size 0x400 — Independent watchdog
0x40003800 SPI2 size 0x400
0x40004400 USART2 size 0x400 — Universal synchronous asynchronous receiver transmitter
0x40004800 USART3 size 0x400
0x40005400 I2C1 size 0x400 — Inter-integrated circuit
0x40005800 I2C2 size 0x400
0x40005C00 I2C3 size 0x400
0x40006000 CRS size 0x400 — Clock recovery system
0x40006800 USB size 0x800 — Universal serial bus full-speed device interface
0x40007000 PWR size 0x400 — Power control
0x40007800 OPAMP size 0x400 — Operational amplifiers
0x40007C00 LPTIM1 size 0x400 — Low power timer
0x40008000 LPUART1 size 0x400 — Universal synchronous asynchronous receiver transmitter
0x40009400 LPTIM2 size 0x400
0x40010000 SYSCFG size 0x30 — System configuration controller
0x40010200 COMP size 0x200 — Comparator
0x40010400 EXTI size 0x400 — External interrupt/event controller
0x40011C00 FIREWALL size 0x400
0x40012C00 TIM1 size 0x400 — Advanced-timers
0x40013000 SPI1 size 0x400 — Serial peripheral interface/Inter-IC sound
0x40013800 USART1 size 0x400 — Universal synchronous asynchronous receiver transmitter
0x40014000 TIM15 size 0x400 — General purpose timers
0x40014400 TIM16 size 0x400 — General purpose timers
0x40020000 DMA1 size 0x400 — Direct memory access controller
0x40020400 DMA2 size 0x400
0x40021000 RCC size 0x400 — Reset and clock control
0x40022000 FLASH size 0x400
0x40023000 CRC size 0x400 — Cyclic redundancy check calculation unit
0x40024000 TSC size 0x400 — Touch sensing controller
0x48000000 GPIOA size 0x400 — General-purpose I/Os
0x48000400 GPIOB size 0x400 — General-purpose I/Os
0x48000800 GPIOC size 0x400 — General-purpose I/Os
0x48000C00 GPIOD size 0x400
0x48001C00 GPIOH size 0x400 — General-purpose I/Os
0x50040000 ADC1 size 0xB9 — Analog-to-Digital Converter
0x50040100 ADC2 size 0xB9
0x50040300 ADC12_Common size 0x11 — Analog-to-Digital Converter
0x50040300 ADC_Common size 0x10 — ADC common registers
0x50060800 RNG size 0x400 — Random number generator
0xA0001000 QUADSPI size 0x400 — QuadSPI interface
0xE0042000 DBGMCU size 0x400 — MCU debug component

## Interrupts
0 WWDG (GPIOB) — Window Watchdog interrupt
1 PVD_PVM (EXTI) — PVD through EXTI line detection
2 RTC_TAMP_STAMP (RTC) — RTC Tamper or TimeStamp /CSS on LSE through EXTI line 19 interrupts
3 RTC_WKUP (RTC) — RTC Wakeup timer through EXTI line 20 interrupt
4 FLASH — Flash global interrupt
5 RCC — RCC global interrupt
6 EXTI0 (EXTI) — EXTI Line 0 interrupt
7 EXTI1 (EXTI) — EXTI Line 1 interrupt
8 EXTI2 (EXTI) — EXTI Line 2 interrupt
9 EXTI3 (EXTI) — EXTI Line 3 interrupt
10 EXTI4 (EXTI) — EXTI Line4 interrupt
11 DMA1_Channel1 (DMA1) — DMA1 Channel1 global interrupt
12 DMA1_Channel2 (DMA1) — DMA1 Channel2 global interrupt
13 DMA1_Channel3 (DMA1) — DMA1 Channel3 interrupt
14 DMA1_Channel4 (DMA1) — DMA1 Channel4 interrupt
15 DMA1_Channel5 (DMA1) — DMA1 Channel5 interrupt
16 DMA1_Channel6 (DMA1) — DMA1 Channel6 interrupt
17 DMA1_Channel7 (DMA1) — DMA1 Channel 7 interrupt
18 ADC1_2 (ADC1) — ADC1 and ADC2 global interrupt
23 EXTI9_5 (EXTI) — EXTI Line5 to Line9 interrupts
24 TIM1_BRK_TIM15 (TIM15) — Timer 15 global interrupt
25 TIM16 (TIM2) — Timer 16 global interrupt
26 TIM1_TRG_COM (TIM16) — TIM1 trigger and commutation interrupt
27 TIM1_CC (TIM16) — TIM1 Capture Compare interrupt
28 TIM2 (TIM6) — TIM2 global interrupt
31 I2C1_EV (I2C1) — I2C1 event interrupt
32 I2C1_ER (I2C1) — I2C1 error interrupt
33 I2C2_EV (I2C2) — I2C2 event interrupt
34 I2C2_ER (I2C2) — I2C2 error interrupt
35 SPI1 — SPI1 global interrupt
36 SPI2 — SPI2 global interrupt
37 USART1 (WWDG, USART3) — USART1 global interrupt
38 USART2 (QUADSPI) — USART2 global interrupt
39 USART3 (GPIOA) — USART3 global interrupt
40 EXTI15_10 (EXTI) — EXTI Lines 10 to 15 interrupts
41 RTC_ALARM (RTC) — RTC alarms through EXTI line 18 interrupts
54 TIM6_DACUNDER (TSC) — TIM6 global and DAC1 underrun error interrupts
56 DMA2_Channel1 (DMA2) — DMA2 Channel 1 global Interrupt
57 DMA2_Channel2 (DMA2) — DMA2 Channel 2 global Interrupt
58 DMA2_Channel3 (DMA2) — DMA2 Channel 3 global Interrupt
59 DMA2_Channel4 (DMA2) — DMA2 Channel 4 global Interrupt
60 DMA2_Channel5 (DMA2) — DMA2 Channel 5 global Interrupt
64 COMP — COMP interrupts
65 LPTIM1 — LP TIM1 interrupt
66 LPTIM2 — LPTIM2 global interrupt
67 USB (GPIOB) — USB event interrupt through EXTI line 17
67 USB_FS (USB) — USB event interrupt through EXTI
68 DMA2_Channel6 (DMA2) — DMA2 Channel 6 global Interrupt
69 DMA2_Channel7 (DMA2) — DMA2 Channel 7 global Interrupt
70 LPUART1 — LPUART1 global interrupt
71 QUADSPI (GPIOC) — QUADSPI global interrupt
72 I2C3_EV (I2C3) — I2C3 event interrupt
73 I2C3_ER (I2C3) — I2C3 error interrupt
77 TSC (USART1) — TSC global interrupt
80 RNG — RNG global interrupt
81 FPU (EXTI) — Floating point unit interrupt
82 CRS — CRS global interrupt
