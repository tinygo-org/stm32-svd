# STM32L562 register map
File version: 1.0
CPU: CM33 r0p1, little endian, MPU, FPU, 3 interrupt priority bits
Registers are 32-bit, read-write, reset 0x0 unless marked. A register's access mark holds for its fields unless they carry their own. Offsets are from the block's base; lines under a group give offsets from that group; [hi:lo] are bit positions; {n}, {i} and the like mark numbered series; 'fields as' and 'values as' point back to an identical list; <NAME> marks a mode.

## Memory map
0x40000000 TIM2 size 0x400 — General-purpose-timers
0x40000400 TIM3 size 0x400 — General-purpose-timers
0x40000800 TIM4 size 0x400 — General-purpose-timers
0x40000C00 TIM5 size 0x400
0x40001000 TIM6 size 0x400 — General-purpose-timers
0x40001400 TIM7 size 0x400 — General-purpose-timers
0x40002800 RTC size 0x400 — Real-time clock
0x40002C00 WWDG size 0x400 — System window watchdog
0x40003000 IWDG size 0x400 — Independent watchdog
0x40003400 TAMP size 0x400 — Tamper and backup registers
0x40003800 SPI2 size 0x400
0x40003C00 SPI3 size 0x400
0x40004400 USART2 size 0x400
0x40004800 USART3 size 0x400
0x40004C00 UART4 size 0x400
0x40005000 UART5 size 0x400
0x40005400 I2C1 size 0x400 — Inter-integrated circuit
0x40005800 I2C2 size 0x400
0x40005C00 I2C3 size 0x400
0x40006000 CRS size 0x400 — Clock recovery system
0x40007000 PWR size 0x400 — Power control
0x40007400 DAC size 0x400
0x40007800 OPAMP size 0x400 — Operational amplifiers
0x40007C00 LPTIM1 size 0x400 — Low power timer
0x40008000 LPUART1 size 0x400 — Universal synchronous asynchronous receiver transmitter
0x40008400 I2C4 size 0x400
0x40009400 LPTIM2 size 0x400
0x40009800 LPTIM3 size 0x400
0x4000A400 FDCAN1 size 0xC00
0x4000D400 USB size 0x800 — Universal serial bus full-speed device interface
0x4000DC00 UCPD1 size 0x400 — USB Power Delivery interface
0x40010000 SYSCFG size 0x30 — System configuration controller
0x40010030 VREFBUF size 0x1D0 — Voltage reference buffer
0x40010200 COMP size 0x200 — Comparator
0x40012C00 TIM1 size 0x400 — Advanced-timers
0x40013000 SPI1 size 0x400 — Serial peripheral interface
0x40013400 TIM8 size 0x400 — Advanced-timers
0x40013800 USART1 size 0x400 — Universal synchronous asynchronous receiver transmitter
0x40014000 TIM15 size 0x400 — General purpose timers
0x40014400 TIM16 size 0x400 — General purpose timers
0x40014800 TIM17 size 0x400 — General purpose timers
0x40015400 SAI1 size 0x400 — Serial audio interface
0x40015800 SAI2 size 0x400
0x40016000 DFSDM1 size 0x800 — Digital filter for sigma delta modulators
0x40020000 DMA1 size 0x400 — Direct memory access controller
0x40020400 DMA2 size 0x400
0x40020800 DMAMUX1 size 0x400 — Direct memory access Multiplexer
0x40021000 RCC size 0x400 — Reset and clock control
0x40022000 FLASH size 0x400
0x40023000 CRC size 0x400 — Cyclic redundancy check calculation unit
0x40024000 TSC size 0x400 — Touch sensing controller
0x4002F400 EXTI size 0x400 — External interrupt/event controller
0x40030400 ICACHE size 0x400
0x40032400 GTZC_TZSC size 0x400
0x40032800 GTZC_TZIC size 0x400
0x40032C00 GTZC_MPCBB1 size 0x400
0x40033000 GTZC_MPCBB2 size 0x400
0x42020000 GPIOA size 0x400 — General-purpose I/Os
0x42020400 GPIOB size 0x400 — General-purpose I/Os
0x42020800 GPIOC size 0x400 — General-purpose I/Os
0x42020C00 GPIOD size 0x400
0x42021000 GPIOE size 0x400
0x42021400 GPIOF size 0x400
0x42021800 GPIOG size 0x400
0x42021C00 GPIOH size 0x400 — General-purpose I/Os
0x42028000 ADC1 size 0xB8 — Analog-to-Digital Converter
0x42028100 ADC2 size 0xB8 — Analog-to-Digital Converter
0x42028300 ADC_Common size 0x10 — Analog-to-Digital Converter
0x420C0000 AES size 0x400 — Advanced encryption standard hardware accelerator 1
0x420C0400 HASH size 0x400 — Hash processor
0x420C0800 RNG size 0x400
0x420C2000 PKA size 0x400
0x420C5000 OTFDEC1 size 0x400 — On-The-Fly Decryption engine
0x420C8000 SDMMC1 size 0x3FD
0x44020000 FMC size 0x400
0x44021000 OCTOSPI1 size 0x400 — OctoSPI
0x50000000 SEC_TIM2 size 0x400
0x50000400 SEC_TIM3 size 0x400
0x50000800 SEC_TIM4 size 0x400
0x50000C00 SEC_TIM5 size 0x400
0x50001000 SEC_TIM6 size 0x400
0x50001400 SEC_TIM7 size 0x400
0x50002800 SEC_RTC size 0x400
0x50002C00 SEC_WWDG size 0x400
0x50003000 SEC_IWDG size 0x400
0x50003400 SEC_TAMP size 0x400
0x50003800 SEC_SPI2 size 0x400
0x50003C00 SEC_SPI3 size 0x400
0x50004400 SEC_USART2 size 0x400
0x50004800 SEC_USART3 size 0x400
0x50004C00 SEC_UART4 size 0x400
0x50005000 SEC_UART5 size 0x400
0x50005400 SEC_I2C1 size 0x400
0x50005800 SEC_I2C2 size 0x400
0x50005C00 SEC_I2C3 size 0x400
0x50006000 SEC_CRS size 0x400
0x50007000 SEC_PWR size 0x400
0x50007400 SEC_DAC size 0x400
0x50007800 SEC_OPAMP size 0x400
0x50007C00 SEC_LPTIM1 size 0x400
0x50008000 SEC_LPUART1 size 0x400
0x50008400 SEC_I2C4 size 0x400
0x50009400 SEC_LPTIM2 size 0x400
0x50009800 SEC_LPTIM3 size 0x400
0x5000A400 SEC_FDCAN1 size 0xC00
0x5000D400 SEC_USB size 0x800
0x5000DC00 SEC_UCPD1 size 0x400
0x50010000 SEC_SYSCFG size 0x30
0x50010030 SEC_VREFBUF size 0x1D0
0x50010200 SEC_COMP size 0x200
0x50012C00 SEC_TIM1 size 0x400
0x50013000 SEC_SPI1 size 0x400
0x50013400 SEC_TIM8 size 0x400
0x50013800 SEC_USART1 size 0x400
0x50014000 SEC_TIM15 size 0x400
0x50014400 SEC_TIM16 size 0x400
0x50014800 SEC_TIM17 size 0x400
0x50015400 SEC_SAI1 size 0x400
0x50015800 SEC_SAI2 size 0x400
0x50016000 SEC_DFSDM1 size 0x800
0x50020000 SEC_DMA1 size 0x400
0x50020400 SEC_DMA2 size 0x400
0x50020800 SEC_DMAMUX1 size 0x400
0x50021000 SEC_RCC size 0x400
0x50022000 SEC_FLASH size 0x400
0x50023000 SEC_CRC size 0x400
0x50024000 SEC_TSC size 0x400
0x5002F400 SEC_EXTI size 0x400
0x50030400 SEC_ICache size 0x400
0x50032400 SEC_GTZC_TZSC size 0x400
0x50032800 SEC_GTZC_TZIC size 0x400
0x50032C00 SEC_GTZC_MPCBB1 size 0x400
0x50033000 SEC_GTZC_MPCBB2 size 0x400
0x52020000 SEC_GPIOA size 0x400
0x52020400 SEC_GPIOB size 0x400
0x52020800 SEC_GPIOC size 0x400
0x52020C00 SEC_GPIOD size 0x400
0x52021000 SEC_GPIOE size 0x400
0x52021400 SEC_GPIOF size 0x400
0x52021800 SEC_GPIOG size 0x400
0x52021C00 SEC_GPIOH size 0x400
0x52028000 SEC_ADC1 size 0xB8
0x52028100 SEC_ADC2 size 0xB8
0x52028300 SEC_ADC_Common size 0x10
0x520C0000 SEC_AES size 0x400
0x520C0400 SEC_HASH size 0x400
0x520C0800 SEC_RNG size 0x400
0x520C2000 SEC_PKA size 0x400
0x520C5000 SEC_OTFDEC1 size 0x400
0x520C8000 SEC_SDMMC1 size 0x3FD
0x54020000 SEC_FMC size 0x400
0x54021000 SEC_OCTOSPI1 size 0x400
0xE000EE08 DCB size 0x5 — Debug Control Block
0xE0044000 DBGMCU size 0x400 — MCU debug component

## Interrupts
0 WWDG — Window Watchdog interrupt
1 PVD_PVM (EXTI) — PVD/PVM1/PVM2/PVM3/PVM4 through EXTI
2 RTC — RTC global interrupts (EXTI line 17)
3 RTC_S (RTC) — RTC secure global interrupts (EXTI line 18)
4 TAMP (EXTI) — TAMPTamper global interrupt (EXTI line 19)
5 TAMP_S (EXTI) — Tamper secure global interrupt (EXTI line 20)
6 FLASH — Flash global interrupt
7 FLASH_S (FLASH) — Flash memory secure global interrupt
8 GTZC (GTZC_TZIC) — TZIC secure global interrupt
9 RCC — RCC global interrupt
10 RCC_S (RCC) — RCC SECURE GLOBAL INTERRUPT
{n+11} EXTI{n} (EXTI) (n=0..15) — EXTI line{n} interrupt
27 DMAMUX1_OVR (DMAMUX1) — DMAMUX overrun interrupt
28 DMAMUX1_OVR_S (DMAMUX1) — DMAMUX1 secure overRun interrupt
29 DMA1_CH1 (DMA1) — DMA1 Channel1 global interrupt
30 DMA1_CH2 (DMA1) — DMA1 Channel2 global interrupt
31 DMA1_CH3 (DMA1) — DMA1 Channel3 interrupt
32 DMA1_CH4 (DMA1) — DMA1 Channel4 interrupt
33 DMA1_CH5 (DMA1) — DMA1 Channel5 interrupt
34 DMA1_CH6 (DMA1) — DMA1 Channel6 interrupt
35 DMA1_CH7 (DMA1) — DMA1 Channel 7 interrupt
36 DMA1_Channel8 (DMA1)
37 ADC1_2 (ADC_Common) — ADC1_2 global interrupt
38 DAC — DAC global interrupt
39 FDCAN1_IT0 (FDCAN1) — FDCAN1 Interrupt 0
40 FDCAN1_IT1 (FDCAN1) — FDCAN1 Interrupt 1
41 TIM1_BRK (TIM1) — TIM1 Break
42 TIM1_UP (TIM1) — TIM1 Update
43 TIM1_TRG_COM (TIM1) — TIM1 Trigger and Commutation
44 TIM1_CC (TIM1) — TIM1 Capture Compare interrupt
45 TIM2 — TIM2 global interrupt
46 TIM3 — TIM3 global interrupt
47 TIM4 — TIM4 global interrupt
48 TIM5 — TIM5 global interrupt
49 TIM6 — TIM6 global interrupt
50 TIM7 — TIM7 global interrupt
51 TIM8_BRK (TIM8) — TIM8 Break Interrupt
52 TIM8_UP (TIM8) — TIM8 Update Interrupt
53 TIM8_TRG_COM (TIM8) — TIM8 Trigger and Commutation Interrupt
54 TIM8_CC (TIM8) — TIM8 Capture Compare Interrupt
55 I2C1_EV (I2C1) — I2C1 event interrupt
56 I2C1_ER (I2C1) — I2C1 error interrupt
57 I2C2_EV (I2C2) — I2C2 event interrupt
58 I2C2_ER (I2C2) — I2C2 error interrupt
59 SPI1 — SPI1 global interrupt
60 SPI2 — SPI2 global interrupt
61 USART1 — USART1 global interrupt
62 USART2 — USART2 global interrupt
63 USART3 — USART3 global interrupt
64 UART4 — UART4 global interrupt
65 UART5 — UART5 global interrupt
66 LPUART1 — LPUART1 global interrupt
67 LPTIM1 — LP TIM1 interrupt
68 LPTIM2 (LPTIM1) — LP TIM2 interrupt
69 TIM15 — TIM15 global interrupt
70 TIM16 — TIM16 global interrupt
71 TIM17 — TIM17 global interrupt
72 COMP — COMP1 and COMP2 interrupts
73 USB_FS (USB) — USB FS global interrupt
74 CRS — Clock recovery system global interrupt
75 FMC — FMC global interrupt
76 OCTOSPI1 — OCTOSPI1 global interrupt
78 SDMMC1 — SDMMC1 global interrupt
{n+79} DMA2_CH{n} (DMA2) (n=1..8)
88 I2C3_EV (I2C3) — I2C3 event interrupt
89 I2C3_ER (I2C3) — I2C3 error interrupt
90 SAI1 — SAI1 global interrupt
91 SAI2 — SAI2 global interrupt
92 TSC — TSC global interrupt
93 AES — AES global interrupts
94 RNG — RNG global interrupt
96 HASH — HASH interrupt
97 PKA — PKA global interrupts
98 LPTIM3
99 SPI3
100 I2C4_ER (I2C4) — I2C4 error interrupt
101 I2C4_EV (I2C4) — I2C4 event interrupt
102 DFSDM1_FLT0 (DFSDM1) — DFSDM1_FLT0 global interrupt
103 DFSDM1_FLT1 (DFSDM1) — DFSDM1_FLT1 global interrupt
104 DFSDM1_FLT2 (DFSDM1) — DFSDM1_FLT2 global interrupt
105 DFSDM1_FLT3 (DFSDM1) — DFSDM1_FLT3 global interrupt
106 UCPD1 — UCPD global interrupt
107 ICACHE
108 OTFDEC1 — OTFDEC1 secure global interrupt
